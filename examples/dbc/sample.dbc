VERSION ""

NS_ :

BS_:

BU_: AS Other

BO_ 256 STATUS: 8 AS
 SG_ Counter : 0|8@1+ (1,0) [0|255] "" Other
 SG_ Speed : 8|16@1+ (0.1,0) [0|6553.5] "km/h" Other

BO_ 257 HEARTBEAT: 4 Other
 SG_ Alive : 0|8@1+ (1,0) [0|255] "" AS
 SG_ Temperature : 8|8@1- (1,-40) [-40|215] "degC" AS

BA_DEF_ BO_ "GenMsgCycleTime" INT 0 65535;
BA_DEF_DEF_ "GenMsgCycleTime" 0;
BA_ "GenMsgCycleTime" BO_ 256 100;
BA_ "GenMsgCycleTime" BO_ 257 500;
